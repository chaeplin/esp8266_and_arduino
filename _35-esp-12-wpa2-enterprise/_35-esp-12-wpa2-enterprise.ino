/*
  WPA2-ENT EAP-TLS
  based on joostd's code : https://github.com/joostd/esp8266-eduroam
  https://github.com/joostd/esp8266-eduroam/blob/master/gen_cert.sh


  wifi_station_set_cert_key
  Function: Set certificate and private key for connecting to WPA2-ENTERPRISE AP.
  Note:
  • Connecting to WPA2-ENTERPRISE AP needs more than 26 KB memory, please ensure enough space (system_get_free_heap_size). ---> 보통 45K 남아 있음
  •  So far, WPA2-ENTERPRISE can only support unencrypted certificate and private key, and only in PEM format.
        ‣ Header of certificate: - - - - - BEGIN CERTIFICATE - - - - -
        ‣ Headerofprivatekey:-----BEGINRSAPRIVATEKEY-----
             or - - - - - BEGIN PRIVATE KEY - - - - -
  •  Please call this API to set certificate and private key before connecting to WPA2-ENTERPRISE AP and the application needs to hold the certificate and private key. Call wifi_station_clear_cert_key to release resources and clear status after connected to the target AP, and then the application can release the certificate and private key.
  •  If the private key is encrypted, please use openssl pkey command to change it to unencrypted file to use, or use openssl rsa related commands to change it (or change the start TAG).

  Prototype:
        bool wifi_station_set_cert_key (
                uint8 *client_cert,
                int client_cert_len,
                uint8 *private_key,
                int private_key_len,
                uint8 *private_key_passwd,
                int private_key_passwd_len,
        )

  Parameter:
        uint8 *client_cert : certificate, HEX array
        int client_cert_len : length of certificate
        uint8 *private_key : private key, HEX array
        int private_key_len : length of private key
        uint8 *private_key_passwd : password for private key, to be supported, can only be NULL now.
        int private_key_passwd_len : length of password, to be supported, can only be 0 now.

  Return:
        0 : succeed   non-0 : fail

  Example:
  For example, the private key is - - - - - BEGIN PRIVATE KEY - - - - - ... ... ... ...
  Then then array should be uint8 key[]={0x2d, 0x2d, 0x2d, 0x2d, 0x2d, 0x42, 0x45, 0x47, ... ... 0x00 };
  It is the ASCII of the characters, and the array needs to be ended by 0x00.
*/



// by chaeplin 2016/01/20
// https://github.com/chaeplin/esp8266_and_arduino
/*
  SERVER : Rpi2(freeradius:EAP-TLS, mosquitto:tls1.1)
  AP : DIR-868L(DD-WRT)
  FreeHeap : 16.7K
*/


#include <ESP8266WiFi.h>
#include <WiFiClientSecure.h>
#include <PubSubClient.h>
#include <ESP8266mDNS.h>
#include <WiFiUdp.h>
#include <ArduinoOTA.h>

extern "C" {
#include "user_interface.h"
}

#include "/usr/local/src/ap_setting.h"

#define DEBUG_PRINT 1

#define MQTT_TEST_SERVER { 192, 168, 10, 144 }
#define MQTT_TEST_USER "test1"
#define MQTT_TEST_PASS "test123"

// test
// 0x2d, 0x2d, 0x2d, 0x2d, 0x2d, 0x42, 0x45, 0x47, 0x49, 0x4e, 0x20, 0x42, --> can't connect
//
// todo : use flash to store crt and key
uint8 espclient1_crt[] = {
  0x2d, 0x2d, 0x2d, 0x2d, 0x2d, 0x42, 0x45, 0x47, 0x49, 0x4e, 0x20, 0x43,
  0x45, 0x52, 0x54, 0x49, 0x46, 0x49, 0x43, 0x41, 0x54, 0x45, 0x2d, 0x2d,
  0x2d, 0x2d, 0x2d, 0x0a, 0x4d, 0x49, 0x49, 0x44, 0x51, 0x6a, 0x43, 0x43,
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  0x2d, 0x2d, 0x2d, 0x0a, 0x00
};

uint8 espclient1_key[] = {
  0x2d, 0x2d, 0x2d, 0x2d, 0x2d, 0x42, 0x45, 0x47, 0x49, 0x4e, 0x20, 0x50,
  0x52, 0x49, 0x56, 0x41, 0x54, 0x45, 0x20, 0x4b, 0x45, 0x59, 0x2d, 0x2d,
  0x2d, 0x2d, 0x2d, 0x0a, 0x4d, 0x49, 0x49, 0x45, 0x76, 0x67, 0x49, 0x42,
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  0x54, 0x45, 0x20, 0x4b, 0x45, 0x59, 0x2d, 0x2d, 0x2d, 0x2d, 0x2d, 0x00
};

// *****************************
//const char* ssid = WIFI_SSID;
//const char* password = WIFI_PASSWORD;


const char* ssid = "freeradius-2G";
const char* password = "any_password_not_used";

const char* otapassword = OTA_PASSWORD;

const char* mqttuser = MQTT_TEST_USER;
const char* mqttpass = MQTT_TEST_PASS;

IPAddress mqtt_server = MQTT_TEST_SERVER;
const char* fingerprint = "70 B2 BF 0D 4E 2A 54 FC DD C3 75 03 CD 42 20 71 9C 4A 97 37";
//connecting to 192.168.10.144
//certificate matches

// test
//const char* fingerprint = "70 B2 BF 0D 4E 2A 54 FC DD C3 75 03 CD 42 20 71 9C 4A 97 36";
//connecting to 192.168.10.144
//certificate doesn't match
//-------------------------------
char* topic = "pubtest";

String clientName;

long lastReconnectAttempt = 0;
long lastMsg = 0;
int test_para = 2000;
unsigned long startMills;

//------------------------------
WiFiClientSecure wifiClient;
//WiFiClient wifiClient;
PubSubClient client(mqtt_server, 8883, wifiClient);

//----------------------
String macToStr(const uint8_t* mac);
void sendmqttMsg(char* topictosend, String payload);


void verifytls() {
  // Use WiFiClientSecure class to create TLS connection
  Serial.print("connecting to ");
  Serial.println(mqtt_server);
  if (!wifiClient.connect(mqtt_server, 8883)) {
    Serial.println("connection failed");
    return;
  }

  if (wifiClient.verify(fingerprint, mqtt_server.toString().c_str())) {
    Serial.println("certificate matches");
  } else {
    Serial.println("certificate doesn't match");
  }
}


//-----------------------
boolean reconnect()
{
  if (!client.connected()) {
    if (client.connect((char*) clientName.c_str(), mqttuser, mqttpass)) {
      if (DEBUG_PRINT) {
        Serial.println("===> mqtt connected");
      }
    } else {
      if (DEBUG_PRINT) {
        Serial.print("---> mqtt failed, rc=");
        Serial.println(client.state());
      }
    }
  }
  return client.connected();
}

void wifi_connect()
{
  if (WiFi.status() != WL_CONNECTED) {
    // WIFI
    if (DEBUG_PRINT) {
      Serial.println();
      Serial.print("===> WIFI ---> Connecting to ");
      Serial.println(ssid);
    }
    delay(10);
    Serial.println("Cert set up");
    wifi_station_set_cert_key(espclient1_crt, sizeof(espclient1_crt), espclient1_key, sizeof(espclient1_key), NULL, 0);
    Serial.println("Cert set done");
    Serial.println("");
    WiFi.mode(WIFI_STA);
    WiFi.begin(ssid, password);

    int Attempt = 0;
    while (WiFi.status() != WL_CONNECTED) {
      if (DEBUG_PRINT) {
        Serial.print(". ");
        Serial.print(Attempt);
      }
      delay(100);
      Attempt++;
      if (Attempt == 150)
      {
        if (DEBUG_PRINT) {
          Serial.println();
          Serial.println("-----> Could not connect to WIFI");
        }
        ESP.restart();
        delay(200);
      }

    }

    wifi_station_clear_cert_key();
    if (DEBUG_PRINT) {
      Serial.println();
      Serial.print("===> WiFi connected");
      Serial.print(" ------> IP address: ");
      Serial.println(WiFi.localIP());
    }
  }
}

void setup()
{
  startMills = millis();

  if (DEBUG_PRINT) {
    Serial.begin(115200);
  }

  wifi_connect();

  clientName += "esp8266-";
  uint8_t mac[6];
  WiFi.macAddress(mac);
  clientName += macToStr(mac);
  clientName += "-";
  clientName += String(micros() & 0xff, 16);

  Serial.println(clientName);

  verifytls();

  //OTA
  // Port defaults to 8266
  //ArduinoOTA.setPort(8266);

  // Hostname defaults to esp8266-[ChipID]
  ArduinoOTA.setHostname("esp-test");


  // No authentication by default
  ArduinoOTA.setPassword(otapassword);

  ArduinoOTA.onStart([]() {
    //Serial.println("Start");
  });
  ArduinoOTA.onEnd([]() {
    //Serial.println("\nEnd");
  });
  ArduinoOTA.onProgress([](unsigned int progress, unsigned int total) {
    //Serial.printf("Progress: %u%%\r", (progress / (total / 100)));
  });
  ArduinoOTA.onError([](ota_error_t error) {
    ESP.restart();
    /*
      if (error == OTA_AUTH_ERROR) abort();
      else if (error == OTA_BEGIN_ERROR) abort();
      else if (error == OTA_CONNECT_ERROR) abort();
      else if (error == OTA_RECEIVE_ERROR) abort();
      else if (error == OTA_END_ERROR) abort();
    */
  });

  ArduinoOTA.begin();
}

void loop()
{
  if (WiFi.status() == WL_CONNECTED) {
    if (!client.connected()) {
      long now = millis();
      if (now - lastReconnectAttempt > 2000) {
        lastReconnectAttempt = now;
        if (reconnect()) {
          lastReconnectAttempt = 0;
        }
      }
    } else {
      long now = millis();
      if (now - lastMsg > test_para) {
        lastMsg = now;
        String payload = "{\"startMills\":";
        payload += (millis() - startMills);
        payload += ",\"FreeHeap\":";
        payload += ESP.getFreeHeap();
        payload += ",\"RSSI\":";
        payload += WiFi.RSSI();
        payload += "}";
        sendmqttMsg(topic, payload);
      }
      client.loop();
      ArduinoOTA.handle();
    }
  } else {
    wifi_connect();
  }

}

void sendmqttMsg(char* topictosend, String payload)
{

  if (client.connected()) {
    if (DEBUG_PRINT) {
      Serial.print("Sending payload: ");
      Serial.print(payload);
    }

    unsigned int msg_length = payload.length();

    if (DEBUG_PRINT) {
      Serial.print(" length: ");
      Serial.println(msg_length);
    }

    byte* p = (byte*)malloc(msg_length);
    memcpy(p, (char*) payload.c_str(), msg_length);

    if ( client.publish(topictosend, p, msg_length)) {
      if (DEBUG_PRINT) {
        Serial.println("Publish ok");
      }
      free(p);
      //return 1;
    } else {
      if (DEBUG_PRINT) {
        Serial.println("Publish failed");
      }
      free(p);
      //return 0;
    }
  }
}

String macToStr(const uint8_t* mac)
{
  String result;
  for (int i = 0; i < 6; ++i) {
    result += String(mac[i], 16);
    if (i < 5)
      result += ':';
  }
  return result;
}
